## arch/arm/mach-imapx200/Kconfig
```kconfig
#arch/arm/mach-imapx200/Kconfig
# Copyright (c) 2009~2014 ShangHai Infotm Ltd all rights reserved. 
# Use of Infotm's code is governed by terms and conditions
# stated in the accompanying licensing statement. 
# Author:
#     ALex Zhang   <tao_zhang@infotm.com>
# Revision History: 
# ----------------
# 1.1  16/09/2009  Alex Zhang   

menu "IMAPX200 Machines"

config MACH_IMAPX200
	bool "IMAPX200"
	select CPU_IMAPX200
	select MACH_IMAP
	help
	  Say Y here if you are using the IMAPX200

endmenu

config CPU_IMAPX200
	bool
	depends on ARCH_IMAP
	help
	  Support for IMAPX200 Infotm Mobile CPU based systems.
```

## arch/arm/plat-imap/Kconfig
```kconfig
# arch/arm/plat-imap/Kconfig
#
# Copyright (c) 2009~2014 ShangHai Infotm Ltd all rights reserved.
#
# Licensed under GPLv2

config PLAT_IMAP
	bool
	depends on ARCH_IMAP
	default y if ARCH_IMAP
	select NO_IOPORT
	select ARCH_REQUIRE_GPIOLIB
	help
	  Base platform code for any Infotm IMAP device

if PLAT_IMAP

#config PLAT_IMAPX200
#	bool "IMAPX200 Platform support"
#	depends on ARCH_IMAP
#	default y if CPU_IMAPX200
#	help
#	  Support for Infotm IMAPX200 CPU based systems.

menuconfig PLAT_IMAPX200
	bool "IMAPX200 Platform support"
	depends on ARCH_IMAP
	default y if CPU_IMAPX200
	help
	  Support for Infotm IMAPX200 CPU based systems.

if PLAT_IMAPX200

choice
	prompt "hardware board code"
	depends on ARCH_IMAP
	help
	  Select board type.

config BOARD_B0
	bool "board b0"
	depends on ARCH_IMAP
	help
	  nand 10 inch
config BOARD_E2
	bool "board e2"
	depends on ARCH_IMAP
	help
	  nand 7 inch
config BOARD_E3
	bool "board e3"
	depends on ARCH_IMAP
	help
	  inand 7 inch	 
config BOARD_E4
	bool "board e4"
	depends on ARCH_IMAP
	help
	  inand 7 inch blue board(e3+)
config BOARD_E5
	bool "board e5"
	depends on ARCH_IMAP
	help
	  inand 7 inch blue board 512M
config BOARD_F0
	bool "board f0"
	depends on ARCH_IMAP
	help
	  inand 7 inch sdio wifi,multi-touch		  
config BOARD_G0
	bool "board g0"
	depends on ARCH_IMAP
	help
	  inand 10 inch	
config BOARD_G0_3G
	bool "board g0 3g"
	depends on ARCH_IMAP
	help
	  inand 10 inch(3g)
config BOARD_H0
	bool "board h0"
	depends on ARCH_IMAP
	help
	  inand 10 inch iron
config BOARD_I0
	bool "board i0"
	depends on ARCH_IMAP
	help
	  inand 8 inch iron
config BOARD_J0
	bool "board j0"
	depends on ARCH_IMAP
	help
	  inand 8 inch
config BOARD_K0
	bool "board k0"
	depends on ARCH_IMAP
	help
	  inand 10 inch gps	  
endchoice

endif

config IMAPX200_PWM
	bool "PWM device support"
	default y if CPU_IMAPX200
	select HAVE_PWM
	help
	  Support for exporting the PWM timer blocks via the pwm device
	  system.

config IMAPX200_DMA
	bool "IMAPX200 DMA support"
	depends on ARCH_IMAP
	help
	  IMAPX200 DMA support. This is needed for drivers like sound which
	  use the DMA system to move data to and from the peripheral blocks.

config IMAPX200_DMA_DEBUG
	bool "IMAPX200 DMA support debug"
	depends on ARCH_IMAP && IMAPX200_DMA
	help
	  Enable debugging output for the DMA code. This option sends info
	  to the kernel log, at priority KERN_DEBUG.

config IMAP_LOWLEVEL_UART_PORT
	int "IMAP UART to use for low-level messages"
	depends on PLAT_IMAP
	default 0
	help
	  Choice of which UART port to use for the low-level messages,
	  such as the `Uncompressing...` at start time. The value of
	  this configuration should be between zero and two. The port
	  must have been initialised by the boot-loader before use.

comment "iMAP Settings"

menu "iMAP Reserved Memory"

config IMAP_RESERVEMEM_SIZE_ETH
	int "Memory Size Reserved for Ethernet (KB)"
	depends on ARCH_IMAP && GMAC_UNIV_ETHERNET
	default "0"
config IMAP_RESERVEMEM_SIZE_PMEM
	int "Memory Size Reserved for Android_pmem (KB)"
	depends on ARCH_IMAP && ANDROID_PMEM
	default "0"

endmenu

config IMAP_FPGA
	bool "iMAP FPGA Clock"
	depends on ARCH_IMAP
	default n
	help
	  If you are operating on the FPGA platform, say Y here!

config FPGA_EXT_CLOCK
	int "FPGA External Clock Setting"
	depends on IMAP_FPGA
	default "40000000"

endif
```

## drivers/asysops/Kconfig
```kconfig
#
# ops_infotm
#
# sololz
#

config ASYSOPS
	bool "Shared memory, message, lock for Android by InfoTM"
	default y
	---help---
	In Android, standard Unix shared memory, message and lock is abandoned 
	by Google. Instead, Google implements a so called binder to do similar
	operations. But we consider it to be so much complex and too hard to 
	preserve, so we write the same driver to implement it with easier usage.

config ASYSOPS_DEBUG
	bool "print Memalloc debug messages"
	depends on ASYSOPS
	default n
```

## drivers/char/sensors/Kconfig
```kconfig
#
# g sensor 
#

menuconfig SENSOR
	tristate "Gsensor support"
	depends on ARCH_IMAP
  default y

if SENSOR

config SENSOR_2AXIS
  depends on ARCH_IMAP 
	boolean "g-sensor simple 2 axis"
	default n

config SENSOR_ACC
  depends on ARCH_IMAP
	boolean "g-sensor aac MMA7660FC"
	default n
	help
	  Say Y here if you intend to run lm-sensors 3.1.1 or older, or any
	  other user-space package which expects i2c adapters to be class
	  devices. If you don't know, say Y.

endif
```

## drivers/ixdsp/Kconfig
```kconfig
#
# DSP subsystem configuration
#

menuconfig IX_DSP_CLASS
	tristate "InfoTM DSP module support"
	default n
	depends on ARCH_IMAP
	help
	  InfoTM DSP module provide various good features.
	  Such as GPS, say Y here to enable DSP subsystem.

if IX_DSP_CLASS

source "drivers/ixdsp/modules/Kconfig"

endif # IX_DSP_CLASS
```

## drivers/ixdsp/modules/Kconfig
```kconfig
#
# Modules base on InfoTM DSP
#

if IX_DSP_CLASS

config IX_DSP_GPS
	tristate "Global Position System"
	default n
	depends on IX_DSP_CLASS
	help
	  Say Y here to enable GPS kernel driver, you must have the 
	  coresponding solid DSP program to make the driver work
	  correctly.

endif # IX_DSP_CLASS
```

## drivers/media/camif/Kconfig
```kconfig
# Haixu Fu
#
config IMAP_CAMIF
	bool "Infotm Imapx200 camif driver"
	default n
	---help---
	This is the driver for iMapx200 camera interface,Say Y here If you
	have a imapx200 product

config IMAP_CAMIF_DEBUG
	bool "Infotm Imapx200 debug"
	depends on IMAP_CAMIF 
	default n
	
```

## drivers/media/decode/Kconfig
```kconfig
# sololz
# never forget super mountain callage

menuconfig IMAP_DECODE
	bool "InfoTM IMAPX200 Decode Support"
	select IMAP_MEMALLOC
	default n
	---help---
	This is a driver for InfoTM IMAPX200 Decode, includes Video, JPEG and Post Processor

config IMAP_DECODE_DEBUG
	bool "print Decode Driver debug messages"
	depends on IMAP_DECODE
	default n

config IMAP_DECODE_SIGNAL_MODE
	bool "use signal to inform decode lib a frame finished"
	depends on IMAP_DECODE
	default n

config IMAP_DECODE_POLL_MODE
	bool "use poll system call to inform decode lib a frame finished"
	depends on IMAP_DECODE
	default y

config IMAP_DEC_HW_PERFORMANCE
	bool "get Decode Driver performance infomation"
	depends on IMAP_DECODE
	default n

config IMAP_DECODE_IC_POWER_TRACE
	bool "print 9170 decoder IC power trace message"
	depends on IMAP_DECODE
	default n
```

## drivers/media/encode/Kconfig
```kconfig
# 
# Kconfig of encode driver.
#
# InfoTM all rights reserved.
#
# Sololz <sololz.luo@gmail.com>.
#

menuconfig IMAP_ENCODE
	bool "InfoTM IMAPX200 Encode Support"
	select IMAP_MEMALLOC
	default n
	---help---
	This is a driver for InfoTM IMAPX200 Encode, includes Video, JPEG

config IMAP_ENCODE_DEBUG
	bool "print Encode Driver debug messages"
	depends on IMAP_ENCODE
	default n

config IMAP_ENCODE_IC_POWER_TRACE
	bool "print 7280 IC power status trace message"
	depends on IMAP_ENCODE
	default n
```

## drivers/memalloc/Kconfig
```kconfig
#
# Kconfig of memalloc.
#
# Sololz <sololz.luo@gmail.com>.
#

menuconfig IMAP_MEMALLOC
	bool "Memory alloc support for multi-media"
	default y
	select IMAP_MPMEM_MANAGEMENT_SUPPORT
	---help---
	Considerring embedded system VPU and GPU need physical linear address buffer, 
	this driver provide physical linear buffer allocation and free operations. 
	And memory mode can be chosen in dynamic kmalloc or static reserved.

if IMAP_MEMALLOC

# Memalloc debug trace.
config IMAP_MEMALLOC_DEBUG
	bool "Print Memalloc debug messages"
	depends on IMAP_MEMALLOC
	default n
config IMAP_MEMALLOC_MEMORY_USAGE_TRACE
	bool "Trace memalloc driver memory usage"
	depends on IMAP_MEMALLOC
	default n

# Deprecated.
config IMAP_MEMALLOC_USE_KMALLOC
	bool "Use kmalloc to do emergency process (NOT COMMENDDED)"
	depends on IMAP_MEMALLOC
	default n

# Memory Pool power management.
config IMAP_MMPOOL_MANAGEMENT
	bool "Communicate with decode driver to process mpool power"
	depends on IMAP_MEMALLOC
	default y
# Memory Pool trace.
config IMAP_MMPOOL_TRACE_POWER
	bool "Trace mmpool power status"
	depends on IMAP_MMPOOL_MANAGEMENT 
	default n

# Main memory type.
choice
	depends on IMAP_MEMALLOC
	prompt "Select reserve memory type"
	default IMAP_MEMALLOC_SYSTEM_RESERVE
config IMAP_MEMALLOC_MANUAL_RESERVE
	bool "Manual reserve memory"
config IMAP_MEMALLOC_SYSTEM_RESERVE
	bool "System reserved memory"
endchoice

# For manual reserved memory.
config IMAP_MEMALLOC_RSV_SIZE
	int "Reserved memory by manual in MB size"
	depends on IMAP_MEMALLOC_MANUAL_RESERVE
	default "64"
	---help---
	This memory region is supposed to be tail part of physical memroy
	range. So it's start and end address depend on total memory size 
	and physical memory start address.
config IMAP_MEMALLOC_TOTAL_SIZE
	int "Total memory size in using"
	depends on IMAP_MEMALLOC_MANUAL_RESERVE
	default "256"
	---help---
	Set the total memory size on your IMAPX200 board.
# For system reserved memory.
config IMAP_MEMALLOC_SYSTEM_RESERVE_SIZE
	int "Reserved memory by system in MB size"
	depends on IMAP_MEMALLOC_SYSTEM_RESERVE
	default "64"
	---help---
	This size might be changed if user get an memory mode promption and 
	more memory mode chosen. Then at next system soft restart kernel will
	check something to reserve more memroy for multi-media usage.
config IMAP_MEMALLOC_MAX_RESERVE_SIZE
	int "Max reserve memory in MB size"
	depends on IMAP_MEMALLOC
	default "96"
	---help---
	Max reserve memroy size set to limit memory usage. If more memory mode
	is set, kernel will use this size to reserve more memory.

# Driver register mode select.
choice
	depends on IMAP_MEMALLOC
	prompt "Selete memalloc driver register mode"
	default IMAP_MEMALLOC_DRIVER_REGISTER_MISC_MODE
config IMAP_MEMALLOC_DRIVER_REGISTER_CLASS_MODE
	bool "Use device_create() to create driver node"
config IMAP_MEMALLOC_DRIVER_REGISTER_MISC_MODE
	bool "Use misc driver model to register"
endchoice

# Shared memory complete support.
config IMAP_SHARED_MEMORY_SUPPORT
	bool "Shared memory support"
	depends on IMAP_MEMALLOC
	default y
	---help---
	Complete support for shared memory for Android system.

# IMAPX Memory Pool memory management support.
config IMAP_MPMEM_MANAGEMENT_SUPPORT
	bool "Memory Pool memory management support"
	depends on IMAP_MEMALLOC
	default y
	---help---
	This part of Memory Pool management is for pretty fast appliction access, net etc.

# A allocator for common use, it is designed to avoid external fragments.
config MEMORY_ALLOCATOR_WITH_NO_EXT_FRAGMENT
	bool "A common allocator with no external fragment"
	default n
	---help---
	This allocator is designed to be an object that can be used in many situations.

# Emulate of android pmem ioctl interfaces.
config EMULATE_ANDROID_PMEM_INTERFACES
	bool "Emulate android pmem ioctl interfaces"
	default y
	---help---
	Memalloc has managed all Android physical memory access functions, but sometimes
	we still need to emulate some pmem interfaces to avoid too much new code changes.

endif	# IMAP_MEMALLOC
```

## drivers/net/gmac-univ_ethernet/Kconfig
```kconfig
#
# GMAC-UNIV_ETHERNET CONFIGURATION
#

config GMAC_UNIV_ETHERNET
	bool "IMAPX200 Gmac_Univ_Ethernet"
	default n
	---help---
	  Support for GMAC-UNIV chipset
	  
	  To compile this driver as a module, choose M here. The module
	  will be called GMAC-UNIV.
```

## drivers/video/infotm/Kconfig
```kconfig
#
# IMAP Video Configuration
#

config FB_IMAP
	tristate "IMAP Framebuffer Support"
	select FB_CFB_FILLRECT
	select FB_CFB_COPYAREA
	select FB_CFB_IMAGEBLIT
	select FRAMEBUFFER_CONSOLE
	select LOGO
	select LOGO_LINUX_LANDSCAPED_CLUT224
	depends on FB && ARCH_IMAP

	default y
	---help---
	TBA

choice
depends on FB_IMAP
prompt "Select LCD Type"
default FB_IMAP_LCD1024X576
config FB_IMAP_LCD800X480
	bool "TFT LCD 800X480"
	---help---
	TBA
config FB_IMAP_LCD800X480_XY
	bool "TFT LCD 800X480 Xing Yuan"
	---help---
	TBA	
config FB_IMAP_LCD800X480_XY2
	bool "TFT LCD 800X480 Xing Yuan 2(stand)"
	---help---
	TBA		
config FB_IMAP_LCD800X600
	bool "TFT LCD 800X600"
	---help---
	TBA	
config FB_IMAP_LCD1024X576
	bool "TFT LCD 1024X576"
	---help---
	TBA
config FB_IMAP_LCD1024X600
	bool "TFT LCD 1024X600"
	---help---
	TBA	
config FB_IMAP_LCD1024X600_QM
	bool "TFT LCD 1024X600 Qi Mei"
	---help---
	TBA	
config FB_IMAP_LCD1024X600_XY
	bool "TFT LCD 1024X600 Xing Yuan"
	---help---
	TBA		
config FB_IMAP_LCD1024X600_7INCH
	bool "TFT LCD 1024X600_7INCH"
	---help---
	TBA		
config FB_IMAP_LCD1024X768_8INCH
	bool "TFT LCD 1024X768_8INCH"
	---help---
	TBA	
config FB_IMAP_LCD1024X768_9INCH
	bool "TFT LCD 1024X768_9INCH"
	---help---
	TBA		
endchoice

config FB_IMAP_BPP
	tristate "Advanced options for IMAP Framebuffer"
	depends on FB_IMAP
	default y
	---help---
	TBA

choice
depends on FB_IMAP_BPP
prompt "Select BPP(Bits Per Pixel)"
default FB_IMAP_BPP16
config FB_IMAP_BPP8
	bool "8BPP A1RGB232"
	---help---
	TBA

config FB_IMAP_BPP16
	bool "16BPP RGB565"
	---help---
	TBA

config FB_IMAP_BPP18
	bool "18BPP RGB666"
	---help---
	TBA

config FB_IMAP_BPP19
	bool "19BPP A1RGB666"
	---help---
	TBA
	
config FB_IMAP_BPP24
	bool "24BPP RGB888"
	---help---
	TBA
	
config FB_IMAP_BPP25
	bool "25BPP A1RGB888"
	---help---
	TBA
	
config FB_IMAP_BPP28
	bool "28BPP A4RGB888"
	---help---
	TBA
	
config FB_IMAP_BPP32
	bool "32BPP A8RGB888"
	---help---
	TBA	
endchoice

config FB_IMAP_NUM
	int "Number of Framebuffers"
	depends on FB_IMAP_BPP && ARCH_IMAP
	default "1"
	---help---
	TBA

config FB_IMAP_VIRTUAL_SCREEN
	bool "Enable Virtual Screen"
	depends on FB_IMAP_BPP

	default n
	---help---
	TBA

config FB_IMAP_DOUBLE_BUFFER
	bool "Enable Double Buffer"
	depends on FB_IMAP_BPP
	default n
	---help---
	TBA

config FB_IMAP_KERNEL_LOGO
	bool "Enable Kernel Logo"
	depends on FB_IMAP_BPP

	default n
	---help---
	TBA

config LCD_FOR_PRODUCT
        bool "Product LCD Driver Select"
        depends on FB_IMAP_BPP

        default n
        ---help---
        If you are using product board, please select this option.

config LCD_ENABLE_IRQ
	bool "Enable LCD interrupt"
	depends on FB_IMAP

	default n
	---help---
	  Enable framebuffer driver to setup a interrupt instance.
```

## drivers/video/infotm_HDMI/Kconfig
```kconfig
#
## TV/VGA Output configuration
#

config HDMI_OUTPUT_SUPPORT
tristate "HDMI Output Support"
depends on FB
default y
---help---
TBA
```
